# netx90_app register map
File version: 1.0
CPU: CM4 r0p1, little endian, MPU, FPU, 4 interrupt priority bits, 78 interrupts
Registers are 32-bit, read-write, reset 0x0 unless marked. A register's access mark holds for its fields unless they carry their own. Offsets are from the block's base; [hi:lo] are bit positions.

## mtgy (part 2 of 2)
Base 0xFF082000
0x16C8 mtgy_op_b50 — MWMM operand B register 50
  [31:0] val — data bits 1631..1600
0x16CC mtgy_op_b51 — MWMM operand B register 51
  [31:0] val — data bits 1663..1632
0x16D0 mtgy_op_b52 — MWMM operand B register 52
  [31:0] val — data bits 1695..1664
0x16D4 mtgy_op_b53 — MWMM operand B register 53
  [31:0] val — data bits 1727..1696
0x16D8 mtgy_op_b54 — MWMM operand B register 54
  [31:0] val — data bits 1759..1728
0x16DC mtgy_op_b55 — MWMM operand B register 55
  [31:0] val — data bits 1791..1760
0x16E0 mtgy_op_b56 — MWMM operand B register 56
  [31:0] val — data bits 1823..1792
0x16E4 mtgy_op_b57 — MWMM operand B register 57
  [31:0] val — data bits 1855..1824
0x16E8 mtgy_op_b58 — MWMM operand B register 58
  [31:0] val — data bits 1887..1856
0x16EC mtgy_op_b59 — MWMM operand B register 59
  [31:0] val — data bits 1919..1888
0x16F0 mtgy_op_b60 — MWMM operand B register 60
  [31:0] val — data bits 1951..1920
0x16F4 mtgy_op_b61 — MWMM operand B register 61
  [31:0] val — data bits 1983..1952
0x16F8 mtgy_op_b62 — MWMM operand B register 62
  [31:0] val — data bits 2015..1984
0x16FC mtgy_op_b63 — MWMM operand B register 63
  [31:0] val — data bits 2047..2016
0x1700 mtgy_op_b64 — MWMM operand B register 64
  [31:0] val — data bits 2079..2048
0x1704 mtgy_op_b65 — MWMM operand B register 65
  [31:0] val — data bits 2111..2080
0x1708 mtgy_op_b66 — MWMM operand B register 66
  [31:0] val — data bits 2143..2112
0x170C mtgy_op_b67 — MWMM operand B register 67
  [31:0] val — data bits 2175..2144
0x1710 mtgy_op_b68 — MWMM operand B register 68
  [31:0] val — data bits 2207..2176
0x1714 mtgy_op_b69 — MWMM operand B register 69
  [31:0] val — data bits 2239..2208
0x1718 mtgy_op_b70 — MWMM operand B register 70
  [31:0] val — data bits 2271..2240
0x171C mtgy_op_b71 — MWMM operand B register 71
  [31:0] val — data bits 2303..2272
0x1720 mtgy_op_b72 — MWMM operand B register 72
  [31:0] val — data bits 2335..2304
0x1724 mtgy_op_b73 — MWMM operand B register 73
  [31:0] val — data bits 2367..2336
0x1728 mtgy_op_b74 — MWMM operand B register 74
  [31:0] val — data bits 2399..2368
0x172C mtgy_op_b75 — MWMM operand B register 75
  [31:0] val — data bits 2431..2400
0x1730 mtgy_op_b76 — MWMM operand B register 76
  [31:0] val — data bits 2463..2432
0x1734 mtgy_op_b77 — MWMM operand B register 77
  [31:0] val — data bits 2495..2464
0x1738 mtgy_op_b78 — MWMM operand B register 78
  [31:0] val — data bits 2527..2496
0x173C mtgy_op_b79 — MWMM operand B register 79
  [31:0] val — data bits 2559..2528
0x1740 mtgy_op_b80 — MWMM operand B register 80
  [31:0] val — data bits 2591..2560
0x1744 mtgy_op_b81 — MWMM operand B register 81
  [31:0] val — data bits 2623..2592
0x1748 mtgy_op_b82 — MWMM operand B register 82
  [31:0] val — data bits 2655..2624
0x174C mtgy_op_b83 — MWMM operand B register 83
  [31:0] val — data bits 2687..2656
0x1750 mtgy_op_b84 — MWMM operand B register 84
  [31:0] val — data bits 2719..2688
0x1754 mtgy_op_b85 — MWMM operand B register 85
  [31:0] val — data bits 2751..2720
0x1758 mtgy_op_b86 — MWMM operand B register 86
  [31:0] val — data bits 2783..2752
0x175C mtgy_op_b87 — MWMM operand B register 87
  [31:0] val — data bits 2815..2784
0x1760 mtgy_op_b88 — MWMM operand B register 88
  [31:0] val — data bits 2847..2816
0x1764 mtgy_op_b89 — MWMM operand B register 89
  [31:0] val — data bits 2879..2848
0x1768 mtgy_op_b90 — MWMM operand B register 90
  [31:0] val — data bits 2911..2880
0x176C mtgy_op_b91 — MWMM operand B register 91
  [31:0] val — data bits 2943..2912
0x1770 mtgy_op_b92 — MWMM operand B register 92
  [31:0] val — data bits 2975..2944
0x1774 mtgy_op_b93 — MWMM operand B register 93
  [31:0] val — data bits 3007..2976
0x1778 mtgy_op_b94 — MWMM operand B register 94
  [31:0] val — data bits 3039..3008
0x177C mtgy_op_b95 — MWMM operand B register 95
  [31:0] val — data bits 3071..3040
0x1780 mtgy_op_b96 — MWMM operand B register 96
  [31:0] val — data bits 3103..3072
0x1784 mtgy_op_b97 — MWMM operand B register 97
  [31:0] val — data bits 3135..3104
0x1788 mtgy_op_b98 — MWMM operand B register 98
  [31:0] val — data bits 3167..3136
0x178C mtgy_op_b99 — MWMM operand B register 99
  [31:0] val — data bits 3199..3168
0x1790 mtgy_op_b100 — MWMM operand B register 100
  [31:0] val — data bits 3231..3200
0x1794 mtgy_op_b101 — MWMM operand B register 101
  [31:0] val — data bits 3263..3232
0x1798 mtgy_op_b102 — MWMM operand B register 102
  [31:0] val — data bits 3295..3264
0x179C mtgy_op_b103 — MWMM operand B register 103
  [31:0] val — data bits 3327..3296
0x17A0 mtgy_op_b104 — MWMM operand B register 104
  [31:0] val — data bits 3359..3328
0x17A4 mtgy_op_b105 — MWMM operand B register 105
  [31:0] val — data bits 3391..3360
0x17A8 mtgy_op_b106 — MWMM operand B register 106
  [31:0] val — data bits 3423..3392
0x17AC mtgy_op_b107 — MWMM operand B register 107
  [31:0] val — data bits 3455..3424
0x17B0 mtgy_op_b108 — MWMM operand B register 108
  [31:0] val — data bits 3487..3456
0x17B4 mtgy_op_b109 — MWMM operand B register 109
  [31:0] val — data bits 3519..3488
0x17B8 mtgy_op_b110 — MWMM operand B register 110
  [31:0] val — data bits 3551..3520
0x17BC mtgy_op_b111 — MWMM operand B register 111
  [31:0] val — data bits 3583..3552
0x17C0 mtgy_op_b112 — MWMM operand B register 112
  [31:0] val — data bits 3615..3584
0x17C4 mtgy_op_b113 — MWMM operand B register 113
  [31:0] val — data bits 3647..3616
0x17C8 mtgy_op_b114 — MWMM operand B register 114
  [31:0] val — data bits 3679..3648
0x17CC mtgy_op_b115 — MWMM operand B register 115
  [31:0] val — data bits 3711..3680
0x17D0 mtgy_op_b116 — MWMM operand B register 116
  [31:0] val — data bits 3743..3712
0x17D4 mtgy_op_b117 — MWMM operand B register 117
  [31:0] val — data bits 3775..3744
0x17D8 mtgy_op_b118 — MWMM operand B register 118
  [31:0] val — data bits 3807..3776
0x17DC mtgy_op_b119 — MWMM operand B register 119
  [31:0] val — data bits 3839..3808
0x17E0 mtgy_op_b120 — MWMM operand B register 120
  [31:0] val — data bits 3871..3840
0x17E4 mtgy_op_b121 — MWMM operand B register 121
  [31:0] val — data bits 3903..3872
0x17E8 mtgy_op_b122 — MWMM operand B register 122
  [31:0] val — data bits 3935..3904
0x17EC mtgy_op_b123 — MWMM operand B register 123
  [31:0] val — data bits 3967..3936
0x17F0 mtgy_op_b124 — MWMM operand B register 124
  [31:0] val — data bits 3999..3968
0x17F4 mtgy_op_b125 — MWMM operand B register 125
  [31:0] val — data bits 4031..4000
0x17F8 mtgy_op_b126 — MWMM operand B register 126
  [31:0] val — data bits 4063..4032
0x17FC mtgy_op_b127 — MWMM operand B register 127
  [31:0] val — data bits 4095..4064
0x1800 mtgy_op_a0 — MWMM operand A register 0
  [31:0] val — data bits 31..0
0x1804 mtgy_op_a1 — MWMM operand A register 1
  [31:0] val — data bits 63..32
0x1808 mtgy_op_a2 — MWMM operand A register 2
  [31:0] val — data bits 95..64
0x180C mtgy_op_a3 — MWMM operand A register 3
  [31:0] val — data bits 127..96
0x1810 mtgy_op_a4 — MWMM operand A register 4
  [31:0] val — data bits 159..128
0x1814 mtgy_op_a5 — MWMM operand A register 5
  [31:0] val — data bits 191..160
0x1818 mtgy_op_a6 — MWMM operand A register 6
  [31:0] val — data bits 223..192
0x181C mtgy_op_a7 — MWMM operand A register 7
  [31:0] val — data bits 255..224
0x1820 mtgy_op_a8 — MWMM operand A register 8
  [31:0] val — data bits 287..256
0x1824 mtgy_op_a9 — MWMM operand A register 9
  [31:0] val — data bits 319..288
0x1828 mtgy_op_a10 — MWMM operand A register 10
  [31:0] val — data bits 351..320
0x182C mtgy_op_a11 — MWMM operand A register 11
  [31:0] val — data bits 383..352
0x1830 mtgy_op_a12 — MWMM operand A register 12
  [31:0] val — data bits 415..384
0x1834 mtgy_op_a13 — MWMM operand A register 13
  [31:0] val — data bits 447..416
0x1838 mtgy_op_a14 — MWMM operand A register 14
  [31:0] val — data bits 479..448
0x183C mtgy_op_a15 — MWMM operand A register 15
  [31:0] val — data bits 511..480
0x1840 mtgy_op_a16 — MWMM operand A register 16
  [31:0] val — data bits 543..512
0x1844 mtgy_op_a17 — MWMM operand A register 17
  [31:0] val — data bits 575..544
0x1848 mtgy_op_a18 — MWMM operand A register 18
  [31:0] val — data bits 607..576
0x184C mtgy_op_a19 — MWMM operand A register 19
  [31:0] val — data bits 639..608
0x1850 mtgy_op_a20 — MWMM operand A register 20
  [31:0] val — data bits 671..640
0x1854 mtgy_op_a21 — MWMM operand A register 21
  [31:0] val — data bits 703..672
0x1858 mtgy_op_a22 — MWMM operand A register 22
  [31:0] val — data bits 735..704
0x185C mtgy_op_a23 — MWMM operand A register 23
  [31:0] val — data bits 767..736
0x1860 mtgy_op_a24 — MWMM operand A register 24
  [31:0] val — data bits 799..768
0x1864 mtgy_op_a25 — MWMM operand A register 25
  [31:0] val — data bits 831..800
0x1868 mtgy_op_a26 — MWMM operand A register 26
  [31:0] val — data bits 863..832
0x186C mtgy_op_a27 — MWMM operand A register 27
  [31:0] val — data bits 895..864
0x1870 mtgy_op_a28 — MWMM operand A register 28
  [31:0] val — data bits 927..896
0x1874 mtgy_op_a29 — MWMM operand A register 29
  [31:0] val — data bits 959..928
0x1878 mtgy_op_a30 — MWMM operand A register 30
  [31:0] val — data bits 991..960
0x187C mtgy_op_a31 — MWMM operand A register 31
  [31:0] val — data bits 1023..992
0x1880 mtgy_op_a32 — MWMM operand A register 32
  [31:0] val — data bits 1055..1024
0x1884 mtgy_op_a33 — MWMM operand A register 33
  [31:0] val — data bits 1087..1056
0x1888 mtgy_op_a34 — MWMM operand A register 34
  [31:0] val — data bits 1119..1088
0x188C mtgy_op_a35 — MWMM operand A register 35
  [31:0] val — data bits 1151..1120
0x1890 mtgy_op_a36 — MWMM operand A register 36
  [31:0] val — data bits 1183..1152
0x1894 mtgy_op_a37 — MWMM operand A register 37
  [31:0] val — data bits 1215..1184
0x1898 mtgy_op_a38 — MWMM operand A register 38
  [31:0] val — data bits 1247..1216
0x189C mtgy_op_a39 — MWMM operand A register 39
  [31:0] val — data bits 1279..1248
0x18A0 mtgy_op_a40 — MWMM operand A register 40
  [31:0] val — data bits 1311..1280
0x18A4 mtgy_op_a41 — MWMM operand A register 41
  [31:0] val — data bits 1343..1312
0x18A8 mtgy_op_a42 — MWMM operand A register 42
  [31:0] val — data bits 1375..1344
0x18AC mtgy_op_a43 — MWMM operand A register 43
  [31:0] val — data bits 1407..1376
0x18B0 mtgy_op_a44 — MWMM operand A register 44
  [31:0] val — data bits 1439..1408
0x18B4 mtgy_op_a45 — MWMM operand A register 45
  [31:0] val — data bits 1471..1440
0x18B8 mtgy_op_a46 — MWMM operand A register 46
  [31:0] val — data bits 1503..1472
0x18BC mtgy_op_a47 — MWMM operand A register 47
  [31:0] val — data bits 1535..1504
0x18C0 mtgy_op_a48 — MWMM operand A register 48
  [31:0] val — data bits 1567..1536
0x18C4 mtgy_op_a49 — MWMM operand A register 49
  [31:0] val — data bits 1599..1568
0x18C8 mtgy_op_a50 — MWMM operand A register 50
  [31:0] val — data bits 1631..1600
0x18CC mtgy_op_a51 — MWMM operand A register 51
  [31:0] val — data bits 1663..1632
0x18D0 mtgy_op_a52 — MWMM operand A register 52
  [31:0] val — data bits 1695..1664
0x18D4 mtgy_op_a53 — MWMM operand A register 53
  [31:0] val — data bits 1727..1696
0x18D8 mtgy_op_a54 — MWMM operand A register 54
  [31:0] val — data bits 1759..1728
0x18DC mtgy_op_a55 — MWMM operand A register 55
  [31:0] val — data bits 1791..1760
0x18E0 mtgy_op_a56 — MWMM operand A register 56
  [31:0] val — data bits 1823..1792
0x18E4 mtgy_op_a57 — MWMM operand A register 57
  [31:0] val — data bits 1855..1824
0x18E8 mtgy_op_a58 — MWMM operand A register 58
  [31:0] val — data bits 1887..1856
0x18EC mtgy_op_a59 — MWMM operand A register 59
  [31:0] val — data bits 1919..1888
0x18F0 mtgy_op_a60 — MWMM operand A register 60
  [31:0] val — data bits 1951..1920
0x18F4 mtgy_op_a61 — MWMM operand A register 61
  [31:0] val — data bits 1983..1952
0x18F8 mtgy_op_a62 — MWMM operand A register 62
  [31:0] val — data bits 2015..1984
0x18FC mtgy_op_a63 — MWMM operand A register 63
  [31:0] val — data bits 2047..2016
0x1900 mtgy_op_a64 — MWMM operand A register 64
  [31:0] val — data bits 2079..2048
0x1904 mtgy_op_a65 — MWMM operand A register 65
  [31:0] val — data bits 2111..2080
0x1908 mtgy_op_a66 — MWMM operand A register 66
  [31:0] val — data bits 2143..2112
0x190C mtgy_op_a67 — MWMM operand A register 67
  [31:0] val — data bits 2175..2144
0x1910 mtgy_op_a68 — MWMM operand A register 68
  [31:0] val — data bits 2207..2176
0x1914 mtgy_op_a69 — MWMM operand A register 69
  [31:0] val — data bits 2239..2208
0x1918 mtgy_op_a70 — MWMM operand A register 70
  [31:0] val — data bits 2271..2240
0x191C mtgy_op_a71 — MWMM operand A register 71
  [31:0] val — data bits 2303..2272
0x1920 mtgy_op_a72 — MWMM operand A register 72
  [31:0] val — data bits 2335..2304
0x1924 mtgy_op_a73 — MWMM operand A register 73
  [31:0] val — data bits 2367..2336
0x1928 mtgy_op_a74 — MWMM operand A register 74
  [31:0] val — data bits 2399..2368
0x192C mtgy_op_a75 — MWMM operand A register 75
  [31:0] val — data bits 2431..2400
0x1930 mtgy_op_a76 — MWMM operand A register 76
  [31:0] val — data bits 2463..2432
0x1934 mtgy_op_a77 — MWMM operand A register 77
  [31:0] val — data bits 2495..2464
0x1938 mtgy_op_a78 — MWMM operand A register 78
  [31:0] val — data bits 2527..2496
0x193C mtgy_op_a79 — MWMM operand A register 79
  [31:0] val — data bits 2559..2528
0x1940 mtgy_op_a80 — MWMM operand A register 80
  [31:0] val — data bits 2591..2560
0x1944 mtgy_op_a81 — MWMM operand A register 81
  [31:0] val — data bits 2623..2592
0x1948 mtgy_op_a82 — MWMM operand A register 82
  [31:0] val — data bits 2655..2624
0x194C mtgy_op_a83 — MWMM operand A register 83
  [31:0] val — data bits 2687..2656
0x1950 mtgy_op_a84 — MWMM operand A register 84
  [31:0] val — data bits 2719..2688
0x1954 mtgy_op_a85 — MWMM operand A register 85
  [31:0] val — data bits 2751..2720
0x1958 mtgy_op_a86 — MWMM operand A register 86
  [31:0] val — data bits 2783..2752
0x195C mtgy_op_a87 — MWMM operand A register 87
  [31:0] val — data bits 2815..2784
0x1960 mtgy_op_a88 — MWMM operand A register 88
  [31:0] val — data bits 2847..2816
0x1964 mtgy_op_a89 — MWMM operand A register 89
  [31:0] val — data bits 2879..2848
0x1968 mtgy_op_a90 — MWMM operand A register 90
  [31:0] val — data bits 2911..2880
0x196C mtgy_op_a91 — MWMM operand A register 91
  [31:0] val — data bits 2943..2912
0x1970 mtgy_op_a92 — MWMM operand A register 92
  [31:0] val — data bits 2975..2944
0x1974 mtgy_op_a93 — MWMM operand A register 93
  [31:0] val — data bits 3007..2976
0x1978 mtgy_op_a94 — MWMM operand A register 94
  [31:0] val — data bits 3039..3008
0x197C mtgy_op_a95 — MWMM operand A register 95
  [31:0] val — data bits 3071..3040
0x1980 mtgy_op_a96 — MWMM operand A register 96
  [31:0] val — data bits 3103..3072
0x1984 mtgy_op_a97 — MWMM operand A register 97
  [31:0] val — data bits 3135..3104
0x1988 mtgy_op_a98 — MWMM operand A register 98
  [31:0] val — data bits 3167..3136
0x198C mtgy_op_a99 — MWMM operand A register 99
  [31:0] val — data bits 3199..3168
0x1990 mtgy_op_a100 — MWMM operand A register 100
  [31:0] val — data bits 3231..3200
0x1994 mtgy_op_a101 — MWMM operand A register 101
  [31:0] val — data bits 3263..3232
0x1998 mtgy_op_a102 — MWMM operand A register 102
  [31:0] val — data bits 3295..3264
0x199C mtgy_op_a103 — MWMM operand A register 103
  [31:0] val — data bits 3327..3296
0x19A0 mtgy_op_a104 — MWMM operand A register 104
  [31:0] val — data bits 3359..3328
0x19A4 mtgy_op_a105 — MWMM operand A register 105
  [31:0] val — data bits 3391..3360
0x19A8 mtgy_op_a106 — MWMM operand A register 106
  [31:0] val — data bits 3423..3392
0x19AC mtgy_op_a107 — MWMM operand A register 107
  [31:0] val — data bits 3455..3424
0x19B0 mtgy_op_a108 — MWMM operand A register 108
  [31:0] val — data bits 3487..3456
0x19B4 mtgy_op_a109 — MWMM operand A register 109
  [31:0] val — data bits 3519..3488
0x19B8 mtgy_op_a110 — MWMM operand A register 110
  [31:0] val — data bits 3551..3520
0x19BC mtgy_op_a111 — MWMM operand A register 111
  [31:0] val — data bits 3583..3552
0x19C0 mtgy_op_a112 — MWMM operand A register 112
  [31:0] val — data bits 3615..3584
0x19C4 mtgy_op_a113 — MWMM operand A register 113
  [31:0] val — data bits 3647..3616
0x19C8 mtgy_op_a114 — MWMM operand A register 114
  [31:0] val — data bits 3679..3648
0x19CC mtgy_op_a115 — MWMM operand A register 115
  [31:0] val — data bits 3711..3680
0x19D0 mtgy_op_a116 — MWMM operand A register 116
  [31:0] val — data bits 3743..3712
0x19D4 mtgy_op_a117 — MWMM operand A register 117
  [31:0] val — data bits 3775..3744
0x19D8 mtgy_op_a118 — MWMM operand A register 118
  [31:0] val — data bits 3807..3776
0x19DC mtgy_op_a119 — MWMM operand A register 119
  [31:0] val — data bits 3839..3808
0x19E0 mtgy_op_a120 — MWMM operand A register 120
  [31:0] val — data bits 3871..3840
0x19E4 mtgy_op_a121 — MWMM operand A register 121
  [31:0] val — data bits 3903..3872
0x19E8 mtgy_op_a122 — MWMM operand A register 122
  [31:0] val — data bits 3935..3904
0x19EC mtgy_op_a123 — MWMM operand A register 123
  [31:0] val — data bits 3967..3936
0x19F0 mtgy_op_a124 — MWMM operand A register 124
  [31:0] val — data bits 3999..3968
0x19F4 mtgy_op_a125 — MWMM operand A register 125
  [31:0] val — data bits 4031..4000
0x19F8 mtgy_op_a126 — MWMM operand A register 126
  [31:0] val — data bits 4063..4032
0x19FC mtgy_op_a127 — MWMM operand A register 127
  [31:0] val — data bits 4095..4064
0x1A00 mtgy_op_e0 — MWMM operand E register 0
  [31:0] val — data bits 31..0
0x1A04 mtgy_op_e1 — MWMM operand E register 1
  [31:0] val — data bits 63..32
0x1A08 mtgy_op_e2 — MWMM operand E register 2
  [31:0] val — data bits 95..64
0x1A0C mtgy_op_e3 — MWMM operand E register 3
  [31:0] val — data bits 127..96
0x1A10 mtgy_op_e4 — MWMM operand E register 4
  [31:0] val — data bits 159..128
0x1A14 mtgy_op_e5 — MWMM operand E register 5
  [31:0] val — data bits 191..160
0x1A18 mtgy_op_e6 — MWMM operand E register 6
  [31:0] val — data bits 223..192
0x1A1C mtgy_op_e7 — MWMM operand E register 7
  [31:0] val — data bits 255..224
0x1A20 mtgy_op_e8 — MWMM operand E register 8
  [31:0] val — data bits 287..256
0x1A24 mtgy_op_e9 — MWMM operand E register 9
  [31:0] val — data bits 319..288
0x1A28 mtgy_op_e10 — MWMM operand E register 10
  [31:0] val — data bits 351..320
0x1A2C mtgy_op_e11 — MWMM operand E register 11
  [31:0] val — data bits 383..352
0x1A30 mtgy_op_e12 — MWMM operand E register 12
  [31:0] val — data bits 415..384
0x1A34 mtgy_op_e13 — MWMM operand E register 13
  [31:0] val — data bits 447..416
0x1A38 mtgy_op_e14 — MWMM operand E register 14
  [31:0] val — data bits 479..448
0x1A3C mtgy_op_e15 — MWMM operand E register 15
  [31:0] val — data bits 511..480
0x1A40 mtgy_op_e16 — MWMM operand E register 16
  [31:0] val — data bits 543..512
0x1A44 mtgy_op_e17 — MWMM operand E register 17
  [31:0] val — data bits 575..544
0x1A48 mtgy_op_e18 — MWMM operand E register 18
  [31:0] val — data bits 607..576
0x1A4C mtgy_op_e19 — MWMM operand E register 19
  [31:0] val — data bits 639..608
0x1A50 mtgy_op_e20 — MWMM operand E register 20
  [31:0] val — data bits 671..640
0x1A54 mtgy_op_e21 — MWMM operand E register 21
  [31:0] val — data bits 703..672
0x1A58 mtgy_op_e22 — MWMM operand E register 22
  [31:0] val — data bits 735..704
0x1A5C mtgy_op_e23 — MWMM operand E register 23
  [31:0] val — data bits 767..736
0x1A60 mtgy_op_e24 — MWMM operand E register 24
  [31:0] val — data bits 799..768
0x1A64 mtgy_op_e25 — MWMM operand E register 25
  [31:0] val — data bits 831..800
0x1A68 mtgy_op_e26 — MWMM operand E register 26
  [31:0] val — data bits 863..832
0x1A6C mtgy_op_e27 — MWMM operand E register 27
  [31:0] val — data bits 895..864
0x1A70 mtgy_op_e28 — MWMM operand E register 28
  [31:0] val — data bits 927..896
0x1A74 mtgy_op_e29 — MWMM operand E register 29
  [31:0] val — data bits 959..928
0x1A78 mtgy_op_e30 — MWMM operand E register 30
  [31:0] val — data bits 991..960
0x1A7C mtgy_op_e31 — MWMM operand E register 31
  [31:0] val — data bits 1023..992
0x1A80 mtgy_op_e32 — MWMM operand E register 32
  [31:0] val — data bits 1055..1024
0x1A84 mtgy_op_e33 — MWMM operand E register 33
  [31:0] val — data bits 1087..1056
0x1A88 mtgy_op_e34 — MWMM operand E register 34
  [31:0] val — data bits 1119..1088
0x1A8C mtgy_op_e35 — MWMM operand E register 35
  [31:0] val — data bits 1151..1120
0x1A90 mtgy_op_e36 — MWMM operand E register 36
  [31:0] val — data bits 1183..1152
0x1A94 mtgy_op_e37 — MWMM operand E register 37
  [31:0] val — data bits 1215..1184
0x1A98 mtgy_op_e38 — MWMM operand E register 38
  [31:0] val — data bits 1247..1216
0x1A9C mtgy_op_e39 — MWMM operand E register 39
  [31:0] val — data bits 1279..1248
0x1AA0 mtgy_op_e40 — MWMM operand E register 40
  [31:0] val — data bits 1311..1280
0x1AA4 mtgy_op_e41 — MWMM operand E register 41
  [31:0] val — data bits 1343..1312
0x1AA8 mtgy_op_e42 — MWMM operand E register 42
  [31:0] val — data bits 1375..1344
0x1AAC mtgy_op_e43 — MWMM operand E register 43
  [31:0] val — data bits 1407..1376
0x1AB0 mtgy_op_e44 — MWMM operand E register 44
  [31:0] val — data bits 1439..1408
0x1AB4 mtgy_op_e45 — MWMM operand E register 45
  [31:0] val — data bits 1471..1440
0x1AB8 mtgy_op_e46 — MWMM operand E register 46
  [31:0] val — data bits 1503..1472
0x1ABC mtgy_op_e47 — MWMM operand E register 47
  [31:0] val — data bits 1535..1504
0x1AC0 mtgy_op_e48 — MWMM operand E register 48
  [31:0] val — data bits 1567..1536
0x1AC4 mtgy_op_e49 — MWMM operand E register 49
  [31:0] val — data bits 1599..1568
0x1AC8 mtgy_op_e50 — MWMM operand E register 50
  [31:0] val — data bits 1631..1600
0x1ACC mtgy_op_e51 — MWMM operand E register 51
  [31:0] val — data bits 1663..1632
0x1AD0 mtgy_op_e52 — MWMM operand E register 52
  [31:0] val — data bits 1695..1664
0x1AD4 mtgy_op_e53 — MWMM operand E register 53
  [31:0] val — data bits 1727..1696
0x1AD8 mtgy_op_e54 — MWMM operand E register 54
  [31:0] val — data bits 1759..1728
0x1ADC mtgy_op_e55 — MWMM operand E register 55
  [31:0] val — data bits 1791..1760
0x1AE0 mtgy_op_e56 — MWMM operand E register 56
  [31:0] val — data bits 1823..1792
0x1AE4 mtgy_op_e57 — MWMM operand E register 57
  [31:0] val — data bits 1855..1824
0x1AE8 mtgy_op_e58 — MWMM operand E register 58
  [31:0] val — data bits 1887..1856
0x1AEC mtgy_op_e59 — MWMM operand E register 59
  [31:0] val — data bits 1919..1888
0x1AF0 mtgy_op_e60 — MWMM operand E register 60
  [31:0] val — data bits 1951..1920
0x1AF4 mtgy_op_e61 — MWMM operand E register 61
  [31:0] val — data bits 1983..1952
0x1AF8 mtgy_op_e62 — MWMM operand E register 62
  [31:0] val — data bits 2015..1984
0x1AFC mtgy_op_e63 — MWMM operand E register 63
  [31:0] val — data bits 2047..2016
0x1B00 mtgy_op_e64 — MWMM operand E register 64
  [31:0] val — data bits 2079..2048
0x1B04 mtgy_op_e65 — MWMM operand E register 65
  [31:0] val — data bits 2111..2080
0x1B08 mtgy_op_e66 — MWMM operand E register 66
  [31:0] val — data bits 2143..2112
0x1B0C mtgy_op_e67 — MWMM operand E register 67
  [31:0] val — data bits 2175..2144
0x1B10 mtgy_op_e68 — MWMM operand E register 68
  [31:0] val — data bits 2207..2176
0x1B14 mtgy_op_e69 — MWMM operand E register 69
  [31:0] val — data bits 2239..2208
0x1B18 mtgy_op_e70 — MWMM operand E register 70
  [31:0] val — data bits 2271..2240
0x1B1C mtgy_op_e71 — MWMM operand E register 71
  [31:0] val — data bits 2303..2272
0x1B20 mtgy_op_e72 — MWMM operand E register 72
  [31:0] val — data bits 2335..2304
0x1B24 mtgy_op_e73 — MWMM operand E register 73
  [31:0] val — data bits 2367..2336
0x1B28 mtgy_op_e74 — MWMM operand E register 74
  [31:0] val — data bits 2399..2368
0x1B2C mtgy_op_e75 — MWMM operand E register 75
  [31:0] val — data bits 2431..2400
0x1B30 mtgy_op_e76 — MWMM operand E register 76
  [31:0] val — data bits 2463..2432
0x1B34 mtgy_op_e77 — MWMM operand E register 77
  [31:0] val — data bits 2495..2464
0x1B38 mtgy_op_e78 — MWMM operand E register 78
  [31:0] val — data bits 2527..2496
0x1B3C mtgy_op_e79 — MWMM operand E register 79
  [31:0] val — data bits 2559..2528
0x1B40 mtgy_op_e80 — MWMM operand E register 80
  [31:0] val — data bits 2591..2560
0x1B44 mtgy_op_e81 — MWMM operand E register 81
  [31:0] val — data bits 2623..2592
0x1B48 mtgy_op_e82 — MWMM operand E register 82
  [31:0] val — data bits 2655..2624
0x1B4C mtgy_op_e83 — MWMM operand E register 83
  [31:0] val — data bits 2687..2656
0x1B50 mtgy_op_e84 — MWMM operand E register 84
  [31:0] val — data bits 2719..2688
0x1B54 mtgy_op_e85 — MWMM operand E register 85
  [31:0] val — data bits 2751..2720
0x1B58 mtgy_op_e86 — MWMM operand E register 86
  [31:0] val — data bits 2783..2752
0x1B5C mtgy_op_e87 — MWMM operand E register 87
  [31:0] val — data bits 2815..2784
0x1B60 mtgy_op_e88 — MWMM operand E register 88
  [31:0] val — data bits 2847..2816
0x1B64 mtgy_op_e89 — MWMM operand E register 89
  [31:0] val — data bits 2879..2848
0x1B68 mtgy_op_e90 — MWMM operand E register 90
  [31:0] val — data bits 2911..2880
0x1B6C mtgy_op_e91 — MWMM operand E register 91
  [31:0] val — data bits 2943..2912
0x1B70 mtgy_op_e92 — MWMM operand E register 92
  [31:0] val — data bits 2975..2944
0x1B74 mtgy_op_e93 — MWMM operand E register 93
  [31:0] val — data bits 3007..2976
0x1B78 mtgy_op_e94 — MWMM operand E register 94
  [31:0] val — data bits 3039..3008
0x1B7C mtgy_op_e95 — MWMM operand E register 95
  [31:0] val — data bits 3071..3040
0x1B80 mtgy_op_e96 — MWMM operand E register 96
  [31:0] val — data bits 3103..3072
0x1B84 mtgy_op_e97 — MWMM operand E register 97
  [31:0] val — data bits 3135..3104
0x1B88 mtgy_op_e98 — MWMM operand E register 98
  [31:0] val — data bits 3167..3136
0x1B8C mtgy_op_e99 — MWMM operand E register 99
  [31:0] val — data bits 3199..3168
0x1B90 mtgy_op_e100 — MWMM operand E register 100
  [31:0] val — data bits 3231..3200
0x1B94 mtgy_op_e101 — MWMM operand E register 101
  [31:0] val — data bits 3263..3232
0x1B98 mtgy_op_e102 — MWMM operand E register 102
  [31:0] val — data bits 3295..3264
0x1B9C mtgy_op_e103 — MWMM operand E register 103
  [31:0] val — data bits 3327..3296
0x1BA0 mtgy_op_e104 — MWMM operand E register 104
  [31:0] val — data bits 3359..3328
0x1BA4 mtgy_op_e105 — MWMM operand E register 105
  [31:0] val — data bits 3391..3360
0x1BA8 mtgy_op_e106 — MWMM operand E register 106
  [31:0] val — data bits 3423..3392
0x1BAC mtgy_op_e107 — MWMM operand E register 107
  [31:0] val — data bits 3455..3424
0x1BB0 mtgy_op_e108 — MWMM operand E register 108
  [31:0] val — data bits 3487..3456
0x1BB4 mtgy_op_e109 — MWMM operand E register 109
  [31:0] val — data bits 3519..3488
0x1BB8 mtgy_op_e110 — MWMM operand E register 110
  [31:0] val — data bits 3551..3520
0x1BBC mtgy_op_e111 — MWMM operand E register 111
  [31:0] val — data bits 3583..3552
0x1BC0 mtgy_op_e112 — MWMM operand E register 112
  [31:0] val — data bits 3615..3584
0x1BC4 mtgy_op_e113 — MWMM operand E register 113
  [31:0] val — data bits 3647..3616
0x1BC8 mtgy_op_e114 — MWMM operand E register 114
  [31:0] val — data bits 3679..3648
0x1BCC mtgy_op_e115 — MWMM operand E register 115
  [31:0] val — data bits 3711..3680
0x1BD0 mtgy_op_e116 — MWMM operand E register 116
  [31:0] val — data bits 3743..3712
0x1BD4 mtgy_op_e117 — MWMM operand E register 117
  [31:0] val — data bits 3775..3744
0x1BD8 mtgy_op_e118 — MWMM operand E register 118
  [31:0] val — data bits 3807..3776
0x1BDC mtgy_op_e119 — MWMM operand E register 119
  [31:0] val — data bits 3839..3808
0x1BE0 mtgy_op_e120 — MWMM operand E register 120
  [31:0] val — data bits 3871..3840
0x1BE4 mtgy_op_e121 — MWMM operand E register 121
  [31:0] val — data bits 3903..3872
0x1BE8 mtgy_op_e122 — MWMM operand E register 122
  [31:0] val — data bits 3935..3904
0x1BEC mtgy_op_e123 — MWMM operand E register 123
  [31:0] val — data bits 3967..3936
0x1BF0 mtgy_op_e124 — MWMM operand E register 124
  [31:0] val — data bits 3999..3968
0x1BF4 mtgy_op_e125 — MWMM operand E register 125
  [31:0] val — data bits 4031..4000
0x1BF8 mtgy_op_e126 — MWMM operand E register 126
  [31:0] val — data bits 4063..4032
0x1BFC mtgy_op_e127 — MWMM operand E register 127
  [31:0] val — data bits 4095..4064
0x1C00 mtgy_op_x0 — MWMM operand X register 0
  [31:0] val — data bits 31..0
0x1C04 mtgy_op_x1 — MWMM operand X register 1
  [31:0] val — data bits 63..32
0x1C08 mtgy_op_x2 — MWMM operand X register 2
  [31:0] val — data bits 95..64
0x1C0C mtgy_op_x3 — MWMM operand X register 3
  [31:0] val — data bits 127..96
0x1C10 mtgy_op_x4 — MWMM operand X register 4
  [31:0] val — data bits 159..128
0x1C14 mtgy_op_x5 — MWMM operand X register 5
  [31:0] val — data bits 191..160
0x1C18 mtgy_op_x6 — MWMM operand X register 6
  [31:0] val — data bits 223..192
0x1C1C mtgy_op_x7 — MWMM operand X register 7
  [31:0] val — data bits 255..224
0x1C20 mtgy_op_x8 — MWMM operand X register 8
  [31:0] val — data bits 287..256
0x1C24 mtgy_op_x9 — MWMM operand X register 9
  [31:0] val — data bits 319..288
0x1C28 mtgy_op_x10 — MWMM operand X register 10
  [31:0] val — data bits 351..320
0x1C2C mtgy_op_x11 — MWMM operand X register 11
  [31:0] val — data bits 383..352
0x1C30 mtgy_op_x12 — MWMM operand X register 12
  [31:0] val — data bits 415..384
0x1C34 mtgy_op_x13 — MWMM operand X register 13
  [31:0] val — data bits 447..416
0x1C38 mtgy_op_x14 — MWMM operand X register 14
  [31:0] val — data bits 479..448
0x1C3C mtgy_op_x15 — MWMM operand X register 15
  [31:0] val — data bits 511..480
0x1C40 mtgy_op_x16 — MWMM operand X register 16
  [31:0] val — data bits 543..512
0x1C44 mtgy_op_x17 — MWMM operand X register 17
  [31:0] val — data bits 575..544
0x1C48 mtgy_op_x18 — MWMM operand X register 18
  [31:0] val — data bits 607..576
0x1C4C mtgy_op_x19 — MWMM operand X register 19
  [31:0] val — data bits 639..608
0x1C50 mtgy_op_x20 — MWMM operand X register 20
  [31:0] val — data bits 671..640
0x1C54 mtgy_op_x21 — MWMM operand X register 21
  [31:0] val — data bits 703..672
0x1C58 mtgy_op_x22 — MWMM operand X register 22
  [31:0] val — data bits 735..704
0x1C5C mtgy_op_x23 — MWMM operand X register 23
  [31:0] val — data bits 767..736
0x1C60 mtgy_op_x24 — MWMM operand X register 24
  [31:0] val — data bits 799..768
0x1C64 mtgy_op_x25 — MWMM operand X register 25
  [31:0] val — data bits 831..800
0x1C68 mtgy_op_x26 — MWMM operand X register 26
  [31:0] val — data bits 863..832
0x1C6C mtgy_op_x27 — MWMM operand X register 27
  [31:0] val — data bits 895..864
0x1C70 mtgy_op_x28 — MWMM operand X register 28
  [31:0] val — data bits 927..896
0x1C74 mtgy_op_x29 — MWMM operand X register 29
  [31:0] val — data bits 959..928
0x1C78 mtgy_op_x30 — MWMM operand X register 30
  [31:0] val — data bits 991..960
0x1C7C mtgy_op_x31 — MWMM operand X register 31
  [31:0] val — data bits 1023..992
0x1C80 mtgy_op_x32 — MWMM operand X register 32
  [31:0] val — data bits 1055..1024
0x1C84 mtgy_op_x33 — MWMM operand X register 33
  [31:0] val — data bits 1087..1056
0x1C88 mtgy_op_x34 — MWMM operand X register 34
  [31:0] val — data bits 1119..1088
0x1C8C mtgy_op_x35 — MWMM operand X register 35
  [31:0] val — data bits 1151..1120
0x1C90 mtgy_op_x36 — MWMM operand X register 36
  [31:0] val — data bits 1183..1152
0x1C94 mtgy_op_x37 — MWMM operand X register 37
  [31:0] val — data bits 1215..1184
0x1C98 mtgy_op_x38 — MWMM operand X register 38
  [31:0] val — data bits 1247..1216
0x1C9C mtgy_op_x39 — MWMM operand X register 39
  [31:0] val — data bits 1279..1248
0x1CA0 mtgy_op_x40 — MWMM operand X register 40
  [31:0] val — data bits 1311..1280
0x1CA4 mtgy_op_x41 — MWMM operand X register 41
  [31:0] val — data bits 1343..1312
0x1CA8 mtgy_op_x42 — MWMM operand X register 42
  [31:0] val — data bits 1375..1344
0x1CAC mtgy_op_x43 — MWMM operand X register 43
  [31:0] val — data bits 1407..1376
0x1CB0 mtgy_op_x44 — MWMM operand X register 44
  [31:0] val — data bits 1439..1408
0x1CB4 mtgy_op_x45 — MWMM operand X register 45
  [31:0] val — data bits 1471..1440
0x1CB8 mtgy_op_x46 — MWMM operand X register 46
  [31:0] val — data bits 1503..1472
0x1CBC mtgy_op_x47 — MWMM operand X register 47
  [31:0] val — data bits 1535..1504
0x1CC0 mtgy_op_x48 — MWMM operand X register 48
  [31:0] val — data bits 1567..1536
0x1CC4 mtgy_op_x49 — MWMM operand X register 49
  [31:0] val — data bits 1599..1568
0x1CC8 mtgy_op_x50 — MWMM operand X register 50
  [31:0] val — data bits 1631..1600
0x1CCC mtgy_op_x51 — MWMM operand X register 51
  [31:0] val — data bits 1663..1632
0x1CD0 mtgy_op_x52 — MWMM operand X register 52
  [31:0] val — data bits 1695..1664
0x1CD4 mtgy_op_x53 — MWMM operand X register 53
  [31:0] val — data bits 1727..1696
0x1CD8 mtgy_op_x54 — MWMM operand X register 54
  [31:0] val — data bits 1759..1728
0x1CDC mtgy_op_x55 — MWMM operand X register 55
  [31:0] val — data bits 1791..1760
0x1CE0 mtgy_op_x56 — MWMM operand X register 56
  [31:0] val — data bits 1823..1792
0x1CE4 mtgy_op_x57 — MWMM operand X register 57
  [31:0] val — data bits 1855..1824
0x1CE8 mtgy_op_x58 — MWMM operand X register 58
  [31:0] val — data bits 1887..1856
0x1CEC mtgy_op_x59 — MWMM operand X register 59
  [31:0] val — data bits 1919..1888
0x1CF0 mtgy_op_x60 — MWMM operand X register 60
  [31:0] val — data bits 1951..1920
0x1CF4 mtgy_op_x61 — MWMM operand X register 61
  [31:0] val — data bits 1983..1952
0x1CF8 mtgy_op_x62 — MWMM operand X register 62
  [31:0] val — data bits 2015..1984
0x1CFC mtgy_op_x63 — MWMM operand X register 63
  [31:0] val — data bits 2047..2016
0x1D00 mtgy_op_x64 — MWMM operand X register 64
  [31:0] val — data bits 2079..2048
0x1D04 mtgy_op_x65 — MWMM operand X register 65
  [31:0] val — data bits 2111..2080
0x1D08 mtgy_op_x66 — MWMM operand X register 66
  [31:0] val — data bits 2143..2112
0x1D0C mtgy_op_x67 — MWMM operand X register 67
  [31:0] val — data bits 2175..2144
0x1D10 mtgy_op_x68 — MWMM operand X register 68
  [31:0] val — data bits 2207..2176
0x1D14 mtgy_op_x69 — MWMM operand X register 69
  [31:0] val — data bits 2239..2208
0x1D18 mtgy_op_x70 — MWMM operand X register 70
  [31:0] val — data bits 2271..2240
0x1D1C mtgy_op_x71 — MWMM operand X register 71
  [31:0] val — data bits 2303..2272
0x1D20 mtgy_op_x72 — MWMM operand X register 72
  [31:0] val — data bits 2335..2304
0x1D24 mtgy_op_x73 — MWMM operand X register 73
  [31:0] val — data bits 2367..2336
0x1D28 mtgy_op_x74 — MWMM operand X register 74
  [31:0] val — data bits 2399..2368
0x1D2C mtgy_op_x75 — MWMM operand X register 75
  [31:0] val — data bits 2431..2400
0x1D30 mtgy_op_x76 — MWMM operand X register 76
  [31:0] val — data bits 2463..2432
0x1D34 mtgy_op_x77 — MWMM operand X register 77
  [31:0] val — data bits 2495..2464
0x1D38 mtgy_op_x78 — MWMM operand X register 78
  [31:0] val — data bits 2527..2496
0x1D3C mtgy_op_x79 — MWMM operand X register 79
  [31:0] val — data bits 2559..2528
0x1D40 mtgy_op_x80 — MWMM operand X register 80
  [31:0] val — data bits 2591..2560
0x1D44 mtgy_op_x81 — MWMM operand X register 81
  [31:0] val — data bits 2623..2592
0x1D48 mtgy_op_x82 — MWMM operand X register 82
  [31:0] val — data bits 2655..2624
0x1D4C mtgy_op_x83 — MWMM operand X register 83
  [31:0] val — data bits 2687..2656
0x1D50 mtgy_op_x84 — MWMM operand X register 84
  [31:0] val — data bits 2719..2688
0x1D54 mtgy_op_x85 — MWMM operand X register 85
  [31:0] val — data bits 2751..2720
0x1D58 mtgy_op_x86 — MWMM operand X register 86
  [31:0] val — data bits 2783..2752
0x1D5C mtgy_op_x87 — MWMM operand X register 87
  [31:0] val — data bits 2815..2784
0x1D60 mtgy_op_x88 — MWMM operand X register 88
  [31:0] val — data bits 2847..2816
0x1D64 mtgy_op_x89 — MWMM operand X register 89
  [31:0] val — data bits 2879..2848
0x1D68 mtgy_op_x90 — MWMM operand X register 90
  [31:0] val — data bits 2911..2880
0x1D6C mtgy_op_x91 — MWMM operand X register 91
  [31:0] val — data bits 2943..2912
0x1D70 mtgy_op_x92 — MWMM operand X register 92
  [31:0] val — data bits 2975..2944
0x1D74 mtgy_op_x93 — MWMM operand X register 93
  [31:0] val — data bits 3007..2976
0x1D78 mtgy_op_x94 — MWMM operand X register 94
  [31:0] val — data bits 3039..3008
0x1D7C mtgy_op_x95 — MWMM operand X register 95
  [31:0] val — data bits 3071..3040
0x1D80 mtgy_op_x96 — MWMM operand X register 96
  [31:0] val — data bits 3103..3072
0x1D84 mtgy_op_x97 — MWMM operand X register 97
  [31:0] val — data bits 3135..3104
0x1D88 mtgy_op_x98 — MWMM operand X register 98
  [31:0] val — data bits 3167..3136
0x1D8C mtgy_op_x99 — MWMM operand X register 99
  [31:0] val — data bits 3199..3168
0x1D90 mtgy_op_x100 — MWMM operand X register 100
  [31:0] val — data bits 3231..3200
0x1D94 mtgy_op_x101 — MWMM operand X register 101
  [31:0] val — data bits 3263..3232
0x1D98 mtgy_op_x102 — MWMM operand X register 102
  [31:0] val — data bits 3295..3264
0x1D9C mtgy_op_x103 — MWMM operand X register 103
  [31:0] val — data bits 3327..3296
0x1DA0 mtgy_op_x104 — MWMM operand X register 104
  [31:0] val — data bits 3359..3328
0x1DA4 mtgy_op_x105 — MWMM operand X register 105
  [31:0] val — data bits 3391..3360
0x1DA8 mtgy_op_x106 — MWMM operand X register 106
  [31:0] val — data bits 3423..3392
0x1DAC mtgy_op_x107 — MWMM operand X register 107
  [31:0] val — data bits 3455..3424
0x1DB0 mtgy_op_x108 — MWMM operand X register 108
  [31:0] val — data bits 3487..3456
0x1DB4 mtgy_op_x109 — MWMM operand X register 109
  [31:0] val — data bits 3519..3488
0x1DB8 mtgy_op_x110 — MWMM operand X register 110
  [31:0] val — data bits 3551..3520
0x1DBC mtgy_op_x111 — MWMM operand X register 111
  [31:0] val — data bits 3583..3552
0x1DC0 mtgy_op_x112 — MWMM operand X register 112
  [31:0] val — data bits 3615..3584
0x1DC4 mtgy_op_x113 — MWMM operand X register 113
  [31:0] val — data bits 3647..3616
0x1DC8 mtgy_op_x114 — MWMM operand X register 114
  [31:0] val — data bits 3679..3648
0x1DCC mtgy_op_x115 — MWMM operand X register 115
  [31:0] val — data bits 3711..3680
0x1DD0 mtgy_op_x116 — MWMM operand X register 116
  [31:0] val — data bits 3743..3712
0x1DD4 mtgy_op_x117 — MWMM operand X register 117
  [31:0] val — data bits 3775..3744
0x1DD8 mtgy_op_x118 — MWMM operand X register 118
  [31:0] val — data bits 3807..3776
0x1DDC mtgy_op_x119 — MWMM operand X register 119
  [31:0] val — data bits 3839..3808
0x1DE0 mtgy_op_x120 — MWMM operand X register 120
  [31:0] val — data bits 3871..3840
0x1DE4 mtgy_op_x121 — MWMM operand X register 121
  [31:0] val — data bits 3903..3872
0x1DE8 mtgy_op_x122 — MWMM operand X register 122
  [31:0] val — data bits 3935..3904
0x1DEC mtgy_op_x123 — MWMM operand X register 123
  [31:0] val — data bits 3967..3936
0x1DF0 mtgy_op_x124 — MWMM operand X register 124
  [31:0] val — data bits 3999..3968
0x1DF4 mtgy_op_x125 — MWMM operand X register 125
  [31:0] val — data bits 4031..4000
0x1DF8 mtgy_op_x126 — MWMM operand X register 126
  [31:0] val — data bits 4063..4032
0x1DFC mtgy_op_x127 — MWMM operand X register 127
  [31:0] val — data bits 4095..4064
